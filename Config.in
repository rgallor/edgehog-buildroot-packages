## Config.in
```kconfig
#
# Copyright 2022 SECO Mind Srl
#
# SPDX-License-Identifier: Apache-2.0
#

source "$BR2_EXTERNAL_EDGEHOG_PATH/package/edgehog-astarte-interface/Config.in"
source "$BR2_EXTERNAL_EDGEHOG_PATH/package/edgehog-device-runtime/Config.in"
source "$BR2_EXTERNAL_EDGEHOG_PATH/package/edgehog-device-hardwareId-service/Config.in"
source "$BR2_EXTERNAL_EDGEHOG_PATH/package/astarte-message-hub/Config.in"
```

## configs/edgehog_device_runtime_defconfig
```kconfig
#
# Copyright 2022 SECO Mind Srl
#
# SPDX-License-Identifier: Apache-2.0
#

BR2_FORTIFY_SOURCE_NONE=y
```

## package/astarte-message-hub/Config.in
```kconfig
#
# Copyright 2023 SECO Mind Srl
#
# SPDX-License-Identifier: Apache-2.0
#

config BR2_PACKAGE_ASTARTE_MESSAGE_HUB
            bool "astarte-message-hub"
            depends on BR2_PACKAGE_HOST_RUSTC_TARGET_ARCH_SUPPORTS
            depends on BR2_PACKAGE_HOST_PROTOBUF_ARCH_SUPPORTS
            depends on BR2_FORTIFY_SOURCE_NONE
            select BR2_PACKAGE_CA_CERTIFICATES
            select BR2_PACKAGE_HOST_RUSTC
            select BR2_PACKAGE_HOST_PROTOBUF
            default y
            help
              A central service that runs on (Linux) devices for collecting and delivering messages
              from N apps using 1 MQTT connection to Astarte.

              https://github.com/astarte-platform/astarte-message-hub

if BR2_PACKAGE_ASTARTE_MESSAGE_HUB

    config BR2_PACKAGE_ASTARTE_MESSAGE_HUB_ASTARTE_REALM
      string "Astarte realm"
      default "test"
      help
            The realm to be used use in Astarte requests.

    config BR2_PACKAGE_ASTARTE_MESSAGE_HUB_ASTARTE_PAIRING_BASE_URL
        string "Astarte pairing base URL"
        default "http://localhost:4003"
        help
            The base URL to reach Astarte Pairing API.This should be the URL up to (and excluding)
            /v1.

    config BR2_PACKAGE_ASTARTE_MESSAGE_HUB_ASTARTE_PAIRING_JWT
        string "Pairing JWT token"
        default ""
        help
            JWT token to authorize device registration.

            Can be obtained with ./generate-astarte-credentials -t pairing -p yourrealmkey.key

    config BR2_PACKAGE_ASTARTE_MESSAGE_HUB_ASTARTE_DEVICE_ID
        string "Astarte Device ID"
        default ""
        help
            Astarte identifies each device with a 128 bit Device ID which has to be unique within
            its Realm

   config BR2_PACKAGE_ASTARTE_MESSAGE_HUB_GRPC_PORT
      int "Astarte Message Hub gRPC port"
      default 50051
      range 1 65535
      help
            The port to be used for gRPC communication with the Nodes.
endif
```

## package/edgehog-astarte-interface/Config.in
```kconfig
#
# Copyright 2022 SECO Mind Srl
#
# SPDX-License-Identifier: Apache-2.0
#

config BR2_PACKAGE_EDGEHOG_ASTARTE_INTERFACE
        bool "edgehog-astarte-interface"
        depends on BR2_PACKAGE_EDGEHOG_DEVICE_RUNTIME
        help
          Edgehog Astarte Interfaces contains the set of interfaces
          that define a common communication schema between Astarte
          remote istance and Edgehog devices.

          https://github.com/edgehog-device-manager/edgehog-astarte-interfaces
```

## package/edgehog-device-hardwareId-service/Config.in
```kconfig
#
# Copyright 2022 SECO Mind Srl
#
# SPDX-License-Identifier: Apache-2.0
#

config BR2_PACKAGE_EDGEHOG_DEVICE_HARDWAREID_SERVICE
            bool "edgehog-device-hardwareId-service"
            depends on BR2_PACKAGE_HOST_RUSTC_TARGET_ARCH_SUPPORTS
            depends on BR2_PACKAGE_DBUS
            depends on BR2_PACKAGE_EDGEHOG_DEVICE_RUNTIME
            select BR2_PACKAGE_HOST_RUSTC
            default y
            help
              Reference project of a service that either fetches hardware id from SMBIOS/DMI or from the kernel command line.            

              https://github.com/edgehog-device-manager/edgehog-device-runtime/tree/main/hardware-id-service
```

## package/edgehog-device-runtime/Config.in
```kconfig
#
# Copyright 2022 SECO Mind Srl
#
# SPDX-License-Identifier: Apache-2.0
#

config BR2_PACKAGE_EDGEHOG_DEVICE_RUNTIME
            bool "edgehog-device-runtime"
            depends on BR2_PACKAGE_HOST_RUSTC_TARGET_ARCH_SUPPORTS
            depends on BR2_PACKAGE_HAS_UDEV
            depends on BR2_PACKAGE_DBUS
            depends on BR2_FORTIFY_SOURCE_NONE
            select BR2_PACKAGE_EDGEHOG_ASTARTE_INTERFACE
            select BR2_PACKAGE_UPOWER
            select BR2_PACKAGE_CA_CERTIFICATES
            select BR2_PACKAGE_HOST_RUSTC
            default y
            help
              This is a portable middleware written in Rust, that enables remote device management 
              on Linux-based systems.

              https://github.com/edgehog-device-manager/edgehog-device-runtime

if BR2_PACKAGE_EDGEHOG_DEVICE_RUNTIME

    config BR2_PACKAGE_EDGEHOG_DEVICE_RUNTIME_ASTARTE_REALM
      string "Astarte realm"
      default "test"
      help
            The realm to be used use in Astarte requests.

    config BR2_PACKAGE_EDGEHOG_DEVICE_RUNTIME_ASTARTE_PAIRING_BASE_URL
        string "Astarte pairing base URL"
        default "http://localhost:4003"
        help
            The base URL to reach Astarte Pairing API.This should be the URL up to (and excluding) /v1.

    config BR2_PACKAGE_EDGEHOG_DEVICE_RUNTIME_ASTARTE_PAIRING_JWT
        string "Pairing JWT token"
        default ""
        help
            JWT token to authorize device registration.

            Can be obtained with ./generate-astarte-credentials -t pairing -p yourrealmkey.key

    config BR2_PACKAGE_EDGEHOG_DEVICE_RUNTIME_ASTARTE_DEVICE_ID
        string "Astarte Device ID"
        default ""
        help
            Astarte identifies each device with a 128 bit Device ID which has to be unique within its Realm

endif
```
